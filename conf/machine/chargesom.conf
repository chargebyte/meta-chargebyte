## conf/machine/chargesom.conf
```bitbake
#@TYPE: Machine
#@NAME: chargebyte Charge SOM Platform
#@SOC: i.MX93
#@DESCRIPTION: Machine configuration for chargebyte Charge SOM boards
#@MAINTAINER: Michael Heimpold <michael.heimpold@chargebyte.com>

MACHINEOVERRIDES =. "mx93:"

include conf/machine/include/imx-base.inc
include conf/machine/include/arm/armv8-2a/tune-cortexa55.inc

KERNEL_DEVICETREE = " \
    freescale/imx93-charge-som-dc-evb.dtb \
"

PREFERRED_PROVIDER_u-boot = "u-boot-imx"
PREFERRED_PROVIDER_virtual/bootloader = "u-boot-imx"
PREFERRED_PROVIDER_virtual/kernel = "linux-imx"
PREFERRED_RPROVIDER_u-boot-fw-utils = "libubootenv"

RAUC_BUNDLE_COMPATIBLE = "chargebyte Charge SOM"

IMX_DEFAULT_BOOTLOADER = "u-boot-imx"
IMX_DEFAULT_KERNEL = "linux-imx"

IMAGE_BOOTLOADER = "imx-boot"

UBOOT_CONFIG_BASENAME = "imx93-charge-som"
UBOOT_DTB_NAME = "imx93-phyboard-segin.dtb"

LOADADDR = ""
UBOOT_SUFFIX = "bin"
UBOOT_MAKE_TARGET = ""

SPL_BINARY = "spl/u-boot-spl.bin"

UBOOT_CONFIG ??= "sd"
UBOOT_CONFIG[sd]   = "${UBOOT_CONFIG_BASENAME}_defconfig,sdcard"

# Set ATF platform name
ATF_PLATFORM = "imx93"

IMXBOOT_TARGETS = "flash_singleboot"

IMX_BOOT_SOC_TARGET = "iMX9"
IMX_BOOT_SEEK = "32"

# Set Serial console
SERIAL_CONSOLES = "115200;ttyLP0"

# Set DDR FIRMWARE
DDR_FIRMWARE_NAME = " \
    lpddr4_dmem_1d_v202201.bin \
    lpddr4_dmem_2d_v202201.bin \
    lpddr4_imem_1d_v202201.bin \
    lpddr4_imem_2d_v202201.bin \
"

# rootfs alignment required for RAUC adaptive update
IMAGE_ROOTFS_ALIGNMENT:update = "4"
```
